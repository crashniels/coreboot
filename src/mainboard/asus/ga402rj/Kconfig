## src/mainboard/asus/ga402rj/Kconfig
```kconfig
# SPDX-License-Identifier: GPL-2.0-only

config BOARD_ASUS_GA402RJ
	select BOARD_ROMSIZE_KB_32768
	select SOC_AMD_MENDOCINO
	select SOC_AMD_REMBRANDT

if BOARD_ASUS_GA402RJ

config MAINBOARD_DIR
	default "asus/ga402rj"

config MAINBOARD_PART_NUMBER
	default "ga402rj"

config FMDFILE
	default "src/mainboard/\$(CONFIG_MAINBOARD_DIR)/coreboot.fmd"

endif
```

## src/mainboard/asus/ga402rj/Kconfig.name
```kconfig
# SPDX-License-Identifier: GPL-2.0-only

config BOARD_ASUS_GA402RJ
	bool "GA402RJ (Zephyrus G14 2022)"
```

## src/mainboard/asus/p8p67_pro/Kconfig.name
```kconfig
## SPDX-License-Identifier: GPL-2.0-only

config BOARD_SYSTEM_MANUFACTURER_SYSTEM_PRODUCT_NAME
	bool "System Product Name"
```

## src/mainboard/gigabyte/ga-z77x-d3h/Kconfig
```kconfig
## SPDX-License-Identifier: GPL-2.0-only

if BOARD_GA_Z77X_D3H

config BOARD_SPECIFIC_OPTIONS
	def_bool y
	select NORTHBRIDGE_INTEL_SANDYBRIDGE
	select USE_NATIVE_RAMINIT
	select SOUTHBRIDGE_INTEL_C216
	select SUPERIO_ITE_IT8728F
	select BOARD_ROMSIZE_KB_8192
	select HAVE_ACPI_TABLES
	select HAVE_OPTION_TABLE
	select HAVE_CMOS_DEFAULT
	select HAVE_ACPI_RESUME
	select INTEL_GMA_HAVE_VBT
	select SERIRQ_CONTINUOUS_MODE
	select MAINBOARD_HAS_LIBGFXINIT
	select MEMORY_MAPPED_TPM

config DRAM_RESET_GATE_GPIO
	int
	# Use GPIO25 because it does not exist on desktop PCHs and because
	# this board does not use DRAM reset gate GPIO
	default 25

config USBDEBUG_HCD_INDEX
	int
	default 2

config MAINBOARD_DIR
	string
	default "gigabyte/ga-z77x-d3h"

config MAINBOARD_PART_NUMBER
	string
	default "GA-Z77X-D3H"

config VGA_BIOS_ID
	string
	default "8086,0162"

endif
```

## src/mainboard/gigabyte/ga-z77x-d3h/Kconfig.name
```kconfig
## SPDX-License-Identifier: GPL-2.0-only

config BOARD_GA_Z77X_D3H
	bool "GA-Z77X-D3H"
```
